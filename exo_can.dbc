VERSION "0.1"

NS_ :

BS_:

BU_: Broadcast CockpitECU HydrogenECU HighPowerECU DriverInterfaceHAT TelemetryBatteryECU

BO_ 999 frame_P0E: 8 Broadcast
	SG_ DestModule : 4|4@1+ (1,0) [0|0] "" Vector__XXX
	SG_ DestSubModule : 0|4@1+ (1,0) [0|0] "" Vector__XXX
	SG_ ErrorType : 8|8@1+ (1,0) [0|0] "" Vector__XXX
	SG_ ErrorData : 16|48@1+ (1,0) [0|0] "" Vector__XXX

BO_ 1007 frame_P0I: 8 Broadcast
	SG_ DestModule : 4|4@1+ (1,0) [0|0] "" Vector__XXX
	SG_ DestSubModule : 0|4@1+ (1,0) [0|0] "" Vector__XXX
	SG_ Instruction : 8|56@1+ (1,0) [0|0] "" Vector__XXX

BO_ 1015 frame_P0D: 8 Broadcast
	SG_ DestModule : 4|4@1+ (1,0) [0|0] "" Vector__XXX
	SG_ DestSubModule : 0|4@1+ (1,0) [0|0] "" Vector__XXX
	SG_ DataType : 8|8@1+ (1,0) [0|0] "" Vector__XXX
	SG_ Data : 16|32@1+ (1,0) [0|0] "" Vector__XXX

BO_ 2023 frame_N0E: 8 Broadcast
	SG_ DestModule : 4|4@1+ (1,0) [0|0] "" Vector__XXX
	SG_ DestSubModule : 0|4@1+ (1,0) [0|0] "" Vector__XXX
	SG_ ErrorType : 8|8@1+ (1,0) [0|0] "" Vector__XXX
	SG_ ErrorData : 16|48@1+ (1,0) [0|0] "" Vector__XXX

BO_ 2031 frame_N0I: 8 Broadcast
	SG_ DestModule : 4|4@1+ (1,0) [0|0] "" Vector__XXX
	SG_ DestSubModule : 0|4@1+ (1,0) [0|0] "" Vector__XXX
	SG_ Instruction : 8|56@1+ (1,0) [0|0] "" Vector__XXX

BO_ 2039 frame_N0D: 8 Broadcast
	SG_ DestModule : 4|4@1+ (1,0) [0|0] "" Vector__XXX
	SG_ DestSubModule : 0|4@1+ (1,0) [0|0] "" Vector__XXX
	SG_ DataType : 8|8@1+ (1,0) [0|0] "" Vector__XXX
	SG_ Data : 16|32@1+ (1,0) [0|0] "" Vector__XXX

BO_ 7 frame_P1E: 8 CockpitECU
	SG_ DestModule : 4|4@1+ (1,0) [0|0] "" Vector__XXX
	SG_ DestSubModule : 0|4@1+ (1,0) [0|0] "" Vector__XXX
	SG_ ErrorType : 8|8@1+ (1,0) [0|0] "" Vector__XXX
	SG_ ErrorData : 16|48@1+ (1,0) [0|0] "" Vector__XXX

BO_ 15 frame_P1I: 8 CockpitECU
	SG_ DestModule : 4|4@1+ (1,0) [0|0] "" Vector__XXX
	SG_ DestSubModule : 0|4@1+ (1,0) [0|0] "" Vector__XXX
	SG_ Instruction : 8|56@1+ (1,0) [0|0] "" Vector__XXX

BO_ 23 frame_P1D: 8 CockpitECU
	SG_ DestModule : 4|4@1+ (1,0) [0|0] "" Vector__XXX
	SG_ DestSubModule : 0|4@1+ (1,0) [0|0] "" Vector__XXX
	SG_ DataType : 8|8@1+ (1,0) [0|0] "" Vector__XXX
	SG_ Data : 16|32@1+ (1,0) [0|0] "" Vector__XXX

BO_ 1031 frame_N1E: 8 CockpitECU
	SG_ DestModule : 4|4@1+ (1,0) [0|0] "" Vector__XXX
	SG_ DestSubModule : 0|4@1+ (1,0) [0|0] "" Vector__XXX
	SG_ ErrorType : 8|8@1+ (1,0) [0|0] "" Vector__XXX
	SG_ ErrorData : 16|48@1+ (1,0) [0|0] "" Vector__XXX

BO_ 1039 frame_N1I: 8 CockpitECU
	SG_ DestModule : 4|4@1+ (1,0) [0|0] "" Vector__XXX
	SG_ DestSubModule : 0|4@1+ (1,0) [0|0] "" Vector__XXX
	SG_ Instruction : 8|56@1+ (1,0) [0|0] "" Vector__XXX

BO_ 1047 frame_N1D: 8 CockpitECU
	SG_ DestModule : 4|4@1+ (1,0) [0|0] "" Vector__XXX
	SG_ DestSubModule : 0|4@1+ (1,0) [0|0] "" Vector__XXX
	SG_ DataType : 8|8@1+ (1,0) [0|0] "" Vector__XXX
	SG_ Data : 16|32@1+ (1,0) [0|0] "" Vector__XXX

BO_ 39 frame_P2E: 8 HydrogenECU
	SG_ DestModule : 4|4@1+ (1,0) [0|0] "" Vector__XXX
	SG_ DestSubModule : 0|4@1+ (1,0) [0|0] "" Vector__XXX
	SG_ ErrorType : 8|8@1+ (1,0) [0|0] "" Vector__XXX
	SG_ ErrorData : 16|48@1+ (1,0) [0|0] "" Vector__XXX

BO_ 47 frame_P2I: 8 HydrogenECU
	SG_ DestModule : 4|4@1+ (1,0) [0|0] "" Vector__XXX
	SG_ DestSubModule : 0|4@1+ (1,0) [0|0] "" Vector__XXX
	SG_ Instruction : 8|56@1+ (1,0) [0|0] "" Vector__XXX

BO_ 55 frame_P2D: 8 HydrogenECU
	SG_ DestModule : 4|4@1+ (1,0) [0|0] "" Vector__XXX
	SG_ DestSubModule : 0|4@1+ (1,0) [0|0] "" Vector__XXX
	SG_ DataType : 8|8@1+ (1,0) [0|0] "" Vector__XXX
	SG_ Data : 16|32@1+ (1,0) [0|0] "" Vector__XXX

BO_ 1063 frame_N2E: 8 HydrogenECU
	SG_ DestModule : 4|4@1+ (1,0) [0|0] "" Vector__XXX
	SG_ DestSubModule : 0|4@1+ (1,0) [0|0] "" Vector__XXX
	SG_ ErrorType : 8|8@1+ (1,0) [0|0] "" Vector__XXX
	SG_ ErrorData : 16|48@1+ (1,0) [0|0] "" Vector__XXX

BO_ 1071 frame_N2I: 8 HydrogenECU
	SG_ DestModule : 4|4@1+ (1,0) [0|0] "" Vector__XXX
	SG_ DestSubModule : 0|4@1+ (1,0) [0|0] "" Vector__XXX
	SG_ Instruction : 8|56@1+ (1,0) [0|0] "" Vector__XXX

BO_ 1079 frame_N2D: 8 HydrogenECU
	SG_ DestModule : 4|4@1+ (1,0) [0|0] "" Vector__XXX
	SG_ DestSubModule : 0|4@1+ (1,0) [0|0] "" Vector__XXX
	SG_ DataType : 8|8@1+ (1,0) [0|0] "" Vector__XXX
	SG_ Data : 16|32@1+ (1,0) [0|0] "" Vector__XXX

BO_ 71 frame_P3E: 8 HighPowerECU
	SG_ DestModule : 4|4@1+ (1,0) [0|0] "" Vector__XXX
	SG_ DestSubModule : 0|4@1+ (1,0) [0|0] "" Vector__XXX
	SG_ ErrorType : 8|8@1+ (1,0) [0|0] "" Vector__XXX
	SG_ ErrorData : 16|48@1+ (1,0) [0|0] "" Vector__XXX

BO_ 79 frame_P3I: 8 HighPowerECU
	SG_ DestModule : 4|4@1+ (1,0) [0|0] "" Vector__XXX
	SG_ DestSubModule : 0|4@1+ (1,0) [0|0] "" Vector__XXX
	SG_ Instruction : 8|56@1+ (1,0) [0|0] "" Vector__XXX

BO_ 87 frame_P3D: 8 HighPowerECU
	SG_ DestModule : 4|4@1+ (1,0) [0|0] "" Vector__XXX
	SG_ DestSubModule : 0|4@1+ (1,0) [0|0] "" Vector__XXX
	SG_ DataType : 8|8@1+ (1,0) [0|0] "" Vector__XXX
	SG_ Data : 16|32@1+ (1,0) [0|0] "" Vector__XXX

BO_ 1095 frame_N3E: 8 HighPowerECU
	SG_ DestModule : 4|4@1+ (1,0) [0|0] "" Vector__XXX
	SG_ DestSubModule : 0|4@1+ (1,0) [0|0] "" Vector__XXX
	SG_ ErrorType : 8|8@1+ (1,0) [0|0] "" Vector__XXX
	SG_ ErrorData : 16|48@1+ (1,0) [0|0] "" Vector__XXX

BO_ 1103 frame_N3I: 8 HighPowerECU
	SG_ DestModule : 4|4@1+ (1,0) [0|0] "" Vector__XXX
	SG_ DestSubModule : 0|4@1+ (1,0) [0|0] "" Vector__XXX
	SG_ Instruction : 8|56@1+ (1,0) [0|0] "" Vector__XXX

BO_ 1111 frame_N3D: 8 HighPowerECU
	SG_ DestModule : 4|4@1+ (1,0) [0|0] "" Vector__XXX
	SG_ DestSubModule : 0|4@1+ (1,0) [0|0] "" Vector__XXX
	SG_ DataType : 8|8@1+ (1,0) [0|0] "" Vector__XXX
	SG_ Data : 16|32@1+ (1,0) [0|0] "" Vector__XXX

BO_ 103 frame_P4E: 8 DriverInterfaceHAT
	SG_ DestModule : 4|4@1+ (1,0) [0|0] "" Vector__XXX
	SG_ DestSubModule : 0|4@1+ (1,0) [0|0] "" Vector__XXX
	SG_ ErrorType : 8|8@1+ (1,0) [0|0] "" Vector__XXX
	SG_ ErrorData : 16|48@1+ (1,0) [0|0] "" Vector__XXX

BO_ 111 frame_P4I: 8 DriverInterfaceHAT
	SG_ DestModule : 4|4@1+ (1,0) [0|0] "" Vector__XXX
	SG_ DestSubModule : 0|4@1+ (1,0) [0|0] "" Vector__XXX
	SG_ Instruction : 8|56@1+ (1,0) [0|0] "" Vector__XXX

BO_ 119 frame_P4D: 8 DriverInterfaceHAT
	SG_ DestModule : 4|4@1+ (1,0) [0|0] "" Vector__XXX
	SG_ DestSubModule : 0|4@1+ (1,0) [0|0] "" Vector__XXX
	SG_ DataType : 8|8@1+ (1,0) [0|0] "" Vector__XXX
	SG_ Data : 16|32@1+ (1,0) [0|0] "" Vector__XXX

BO_ 1127 frame_N4E: 8 DriverInterfaceHAT
	SG_ DestModule : 4|4@1+ (1,0) [0|0] "" Vector__XXX
	SG_ DestSubModule : 0|4@1+ (1,0) [0|0] "" Vector__XXX
	SG_ ErrorType : 8|8@1+ (1,0) [0|0] "" Vector__XXX
	SG_ ErrorData : 16|48@1+ (1,0) [0|0] "" Vector__XXX

BO_ 1135 frame_N4I: 8 DriverInterfaceHAT
	SG_ DestModule : 4|4@1+ (1,0) [0|0] "" Vector__XXX
	SG_ DestSubModule : 0|4@1+ (1,0) [0|0] "" Vector__XXX
	SG_ Instruction : 8|56@1+ (1,0) [0|0] "" Vector__XXX

BO_ 1143 frame_N4D: 8 DriverInterfaceHAT
	SG_ DestModule : 4|4@1+ (1,0) [0|0] "" Vector__XXX
	SG_ DestSubModule : 0|4@1+ (1,0) [0|0] "" Vector__XXX
	SG_ DataType : 8|8@1+ (1,0) [0|0] "" Vector__XXX
	SG_ Data : 16|32@1+ (1,0) [0|0] "" Vector__XXX

BO_ 135 frame_P5E: 8 TelemetryBatteryECU
	SG_ DestModule : 4|4@1+ (1,0) [0|0] "" Vector__XXX
	SG_ DestSubModule : 0|4@1+ (1,0) [0|0] "" Vector__XXX
	SG_ ErrorType : 8|8@1+ (1,0) [0|0] "" Vector__XXX
	SG_ ErrorData : 16|48@1+ (1,0) [0|0] "" Vector__XXX

BO_ 143 frame_P5I: 8 TelemetryBatteryECU
	SG_ DestModule : 4|4@1+ (1,0) [0|0] "" Vector__XXX
	SG_ DestSubModule : 0|4@1+ (1,0) [0|0] "" Vector__XXX
	SG_ Instruction : 8|56@1+ (1,0) [0|0] "" Vector__XXX

BO_ 151 frame_P5D: 8 TelemetryBatteryECU
	SG_ DestModule : 4|4@1+ (1,0) [0|0] "" Vector__XXX
	SG_ DestSubModule : 0|4@1+ (1,0) [0|0] "" Vector__XXX
	SG_ DataType : 8|8@1+ (1,0) [0|0] "" Vector__XXX
	SG_ Data : 16|32@1+ (1,0) [0|0] "" Vector__XXX

BO_ 1159 frame_N5E: 8 TelemetryBatteryECU
	SG_ DestModule : 4|4@1+ (1,0) [0|0] "" Vector__XXX
	SG_ DestSubModule : 0|4@1+ (1,0) [0|0] "" Vector__XXX
	SG_ ErrorType : 8|8@1+ (1,0) [0|0] "" Vector__XXX
	SG_ ErrorData : 16|48@1+ (1,0) [0|0] "" Vector__XXX

BO_ 1167 frame_N5I: 8 TelemetryBatteryECU
	SG_ DestModule : 4|4@1+ (1,0) [0|0] "" Vector__XXX
	SG_ DestSubModule : 0|4@1+ (1,0) [0|0] "" Vector__XXX
	SG_ Instruction : 8|56@1+ (1,0) [0|0] "" Vector__XXX

BO_ 1175 frame_N5D: 8 TelemetryBatteryECU
	SG_ DestModule : 4|4@1+ (1,0) [0|0] "" Vector__XXX
	SG_ DestSubModule : 0|4@1+ (1,0) [0|0] "" Vector__XXX
	SG_ DataType : 8|8@1+ (1,0) [0|0] "" Vector__XXX
	SG_ Data : 16|32@1+ (1,0) [0|0] "" Vector__XXX

VAL_ 1015 DataType 1 "Voltage" 2 "Current" 3 "Power" 4 "Energy" 5 "BatteryCharge" 6 "Efficiency" 33 "Temperature" 34 "Pressure" 49 "ActuatorState" 50 "BoatState" 51 "IsolationState" 52 "IsolationResistance" ;
VAL_ 2039 DataType 1 "Voltage" 2 "Current" 3 "Power" 4 "Energy" 5 "BatteryCharge" 6 "Efficiency" 33 "Temperature" 34 "Pressure" 49 "ActuatorState" 50 "BoatState" 51 "IsolationState" 52 "IsolationResistance" ;
VAL_ 23 DataType 1 "Voltage" 2 "Current" 3 "Power" 4 "Energy" 5 "BatteryCharge" 6 "Efficiency" 33 "Temperature" 34 "Pressure" 49 "ActuatorState" 50 "BoatState" 51 "IsolationState" 52 "IsolationResistance" ;
VAL_ 1047 DataType 1 "Voltage" 2 "Current" 3 "Power" 4 "Energy" 5 "BatteryCharge" 6 "Efficiency" 33 "Temperature" 34 "Pressure" 49 "ActuatorState" 50 "BoatState" 51 "IsolationState" 52 "IsolationResistance" ;
VAL_ 55 DataType 1 "Voltage" 2 "Current" 3 "Power" 4 "Energy" 5 "BatteryCharge" 6 "Efficiency" 33 "Temperature" 34 "Pressure" 49 "ActuatorState" 50 "BoatState" 51 "IsolationState" 52 "IsolationResistance" ;
VAL_ 1079 DataType 1 "Voltage" 2 "Current" 3 "Power" 4 "Energy" 5 "BatteryCharge" 6 "Efficiency" 33 "Temperature" 34 "Pressure" 49 "ActuatorState" 50 "BoatState" 51 "IsolationState" 52 "IsolationResistance" ;
VAL_ 87 DataType 1 "Voltage" 2 "Current" 3 "Power" 4 "Energy" 5 "BatteryCharge" 6 "Efficiency" 33 "Temperature" 34 "Pressure" 49 "ActuatorState" 50 "BoatState" 51 "IsolationState" 52 "IsolationResistance" ;
VAL_ 1111 DataType 1 "Voltage" 2 "Current" 3 "Power" 4 "Energy" 5 "BatteryCharge" 6 "Efficiency" 33 "Temperature" 34 "Pressure" 49 "ActuatorState" 50 "BoatState" 51 "IsolationState" 52 "IsolationResistance" ;
VAL_ 119 DataType 1 "Voltage" 2 "Current" 3 "Power" 4 "Energy" 5 "BatteryCharge" 6 "Efficiency" 33 "Temperature" 34 "Pressure" 49 "ActuatorState" 50 "BoatState" 51 "IsolationState" 52 "IsolationResistance" ;
VAL_ 1143 DataType 1 "Voltage" 2 "Current" 3 "Power" 4 "Energy" 5 "BatteryCharge" 6 "Efficiency" 33 "Temperature" 34 "Pressure" 49 "ActuatorState" 50 "BoatState" 51 "IsolationState" 52 "IsolationResistance" ;
VAL_ 151 DataType 1 "Voltage" 2 "Current" 3 "Power" 4 "Energy" 5 "BatteryCharge" 6 "Efficiency" 33 "Temperature" 34 "Pressure" 49 "ActuatorState" 50 "BoatState" 51 "IsolationState" 52 "IsolationResistance" ;
VAL_ 1175 DataType 1 "Voltage" 2 "Current" 3 "Power" 4 "Energy" 5 "BatteryCharge" 6 "Efficiency" 33 "Temperature" 34 "Pressure" 49 "ActuatorState" 50 "BoatState" 51 "IsolationState" 52 "IsolationResistance" ;
